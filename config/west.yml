## config/west.yml
```yaml
manifest:
  remotes:
    # zmk official
    - name: zmkfirmware
      url-base: https://github.com/zmkfirmware
      # bravekarma
    - name: caksoylar
      url-base: https://github.com/caksoylar
      # kyek / duckyb
    - name: duckyb
      url-base: https://github.com/duckyb
      # nice!view gem
    - name: PiXeL16
      url-base: https://github.com/PiXeL16
      # prospector
    - name: janpfischer
      url-base: https://github.com/janpfischer
  projects:
    - name: zmk
      remote: zmkfirmware
      revision: v0.3.0
      import: app/west.yml
    - name: urchin-zmk-module
      remote: duckyb
      revision: main
    - name: zmk-landscape-slideshow
      remote: PiXeL16
      revision: main
    - name: zmk-dongle-screen
      remote: janpfischer
      revision: main
  self:
    path: config
```
